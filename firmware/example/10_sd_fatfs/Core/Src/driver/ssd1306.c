#include "ssd1306.h"
#include <string.h>

#define DATA_MODE_REG_ADDRESS 0x40
#define CMD_MODE_REG_ADDRESS  0x00

static uint8_t ssd1306_buffer[SSD1306_WIDTH * SSD1306_HEIGHT / 8];
static uint8_t cursor_x = 0;
static uint8_t cursor_y = 0;

/**
 * @brief 5x7 폰트 배열 (ASCII 32-126) : 한글은 지원 X
 */
static const uint8_t Font5x7[][5] = {
  {0x00, 0x00, 0x00, 0x00, 0x00}, // 공백 (32)
  {0x00, 0x00, 0x5F, 0x00, 0x00}, // !
  {0x00, 0x07, 0x00, 0x07, 0x00}, // "
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  {0x08, 0x08, 0x2A, 0x1C, 0x08}, // ~
};

/**
 * @brief i2c write 함수 : [인자별 뜻] : i2c핸들러 포인터/ slave 주소/ 메모리 주소/ 메모리 주소 크기/ 전송할 데이터 포인터/ 전송할 바이트 수/ 타임아웃
 * @details SSD1306에서 "CMD_MODE_REG_ADDRESS"는 명령(Command) 레지스터이다.
 */
static bool ssd1306WriteCommand(uint8_t cmd)
{
  return HAL_I2C_Mem_Write(&hi2c1, SSD1306_I2C_ADDR, CMD_MODE_REG_ADDRESS, 1, &cmd, 1, HAL_MAX_DELAY) == HAL_OK;
}

/**
 * @brief 인자로 쓰여진 16진수는 대부분 데이터 시트에 기재된 고정된 명령어 입니다.
 */
bool ssd1306Init(void)
{
  ssd1306WriteCommand(0xAE); // 디스플레이 OFF (명령)

  ssd1306WriteCommand(0x40); // Start Line = 0 (화면 맨 위부터)
  ssd1306WriteCommand(0xD3); // Display Offset 설정
  ssd1306WriteCommand(0x00); // Offset = 0  (필요한 이유 : oled의 첫번째 페이지 기준을 설정하기 위함)

  ssd1306WriteCommand(0xA8); // 화면 비율 설정 (명령: 다음바이트를 해상도로 인식)
  ssd1306WriteCommand(0x3F); // 64 = 0x3F (값 : 높이 설정)

  // COM 핀 설정 (하드웨어 의존)
  ssd1306WriteCommand(0xDA); // 행에 대응하는 배선을 세팅한다. (명령 : 다음바이트 응답값에 따라 설정)
  ssd1306WriteCommand(0x12); // 128x64 표준 배선 (값)

  ssd1306WriteCommand(0xA1); // 상하 좌우 반전
  ssd1306WriteCommand(0xC8);

  // Charge Pump (내부 전원)
  ssd1306WriteCommand(0x8D); // 전원방식 설정 (명령 : 다음바이트 응답값에 따라 설정)
  ssd1306WriteCommand(0x14); // 내부 승압 회로 사용 (값)

  ssd1306WriteCommand(0xAF); // 디스플레이 ON (명령)
  
  ssd1306Clear();
  return true;
}

/**
 * @brief 화면을 칠하는 함수 : 인자로 1 = 흰색으로 전체 칠하기, 인자로 0 = 검은색으로 전체 칠하기
 */
void ssd1306Fill(uint8_t color)
{
  memset(ssd1306_buffer, (color ? 0xFF : 0x00), sizeof(ssd1306_buffer)); // 버퍼에 정보를 담아둔다 
}

/**
 * @brief 화면을 깨끗하게 지우는 함수
 */
void ssd1306Clear(void)
{
  ssd1306Fill(0);        // 화면을 검정으로 칠한다.
  ssd1306UpdateScreen(); // i2c로 OLED에 버퍼 전송 (실제 화면 갱신)
  cursor_x = 0;           // 텍스트 커서를 맨 왼쪽으로
  cursor_y = 0;           // 텍스트 커서를 맨 위로
}

/**
 * @brief 버퍼에 담긴 그래픽 정보를 실제로 출력한다.
 * @details oled는 8개의 페이지(행)으로 관리되며 열은 총 128개로 각 페이지 하나당 세로 8픽셀, 가로 128픽셀이라고 생각하면 편하다.
 */
void ssd1306UpdateScreen(void)
{
  for (uint8_t i = 0; i < 8; i++)
  {
    ssd1306WriteCommand(0xB0 + i); // 페이지를 하나씩 선택한다.
    ssd1306WriteCommand(0x00); // 페이지내 가로 시작주소를 LSB와 MSB로 나눠서 보낸다. LSB = 0
    ssd1306WriteCommand(0x10); // MSB = 0
    HAL_I2C_Mem_Write(&hi2c1, SSD1306_I2C_ADDR, DATA_MODE_REG_ADDRESS, 1, &ssd1306_buffer[SSD1306_WIDTH * i], SSD1306_WIDTH, HAL_MAX_DELAY); // 0번지부터 모든 열에 대한 버퍼내 데이터를 뿌린다.
  }
}
/**
 * @brief 커서 설정
 */
void ssd1306SetCursor(uint8_t x, uint8_t y)
{
  cursor_x = x;
  cursor_y = y;
}

/**
 * @brief 단일 문자 설정
 */
void ssd1306WriteChar(char ch)
{
  if (ch < 32 || ch > 126) // 범위 내 문자만 받겠다는 선언
    ch = ' ';

  uint8_t idx = ch - 32; // 폰트 테이블 (위에서 선언)내 공백은 인덱스 0번이므로, 기준을 맞춰준다.

  if (cursor_x + 6 > SSD1306_WIDTH) // 문자 하나는 가로 5픽셀이다. 이번턴의 출력위치가 해상도의 끝을 넘어가버리면 안되니 다음줄로 이동한다.
  {
    cursor_x = 0;
    cursor_y += 8; // 다음 텍스트 줄 (폰트 높이 8px)

    if (cursor_y + 8 > SSD1306_HEIGHT) // 문자 하나는 세로 7픽셀이다.단 페이지가 8픽셀이므로 8단위로 끊어준다. 해당 픽셀범위가 세로 해상도 범위를 넘기면 안되니,oled 전체 초기화 후 맨 위로 다시 이동한다.
    {
      ssd1306Fill(0);        // 화면을 검정으로 칠한다.
      ssd1306UpdateScreen();
      cursor_y = 0;
    }
  }

  for (uint8_t i = 0; i < 5; i++)
  {
    if (cursor_x >= SSD1306_WIDTH) // 문자 출력 위치가 가로 길이를 넘어가면 중지한다.
      break;

    for (uint8_t j = 0; j < 8; j++) // 한 컬럼당 (페이지는 8비트의 행으로 구성됨) 세로 비트 0 - 7
    {
      if (Font5x7[idx][i] & (1 << j)) // 폰트 정보를 토대로 한 컬럼 내 8비트 배열에서 어느 위치의 픽셀을 켜야하는지 확인
      {
        uint16_t pos = cursor_x + ((cursor_y + j) / 8) * SSD1306_WIDTH; // 지금 켜려는 이 픽셀이,ssd1306_buffer[] 배열의 몇 번째 칸에 들어가야 하는지 계산
        if (pos < sizeof(ssd1306_buffer)) 
          ssd1306_buffer[pos] |= 1 << ((cursor_y + j) % 8); // 버퍼에 해당 픽셀 정보를 저장한다.
      }
    }
    cursor_x++; // 다음 위치
  }
  cursor_x++; // 문자 간 간격
}

/**
 * @brief 복수 문자 설정
 */
void ssd1306WriteString(const char *str)
{
  while (*str)
  {
    ssd1306WriteChar(*str++);
  }
}
